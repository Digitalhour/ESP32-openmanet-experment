## firmware/batman-probe/main/Kconfig.projbuild
```kconfig
menu "batman-probe"

    config BATP_WIFI_SSID
        string "Wi-Fi network to join (the LAN the Linux batman-adv peer is on)"
        default "nicc new"

    config BATP_WIFI_PSK
        string "Wi-Fi password"
        default ""
        help
            Stored in sdkconfig (gitignored) and in the firmware. Enter it with
            idf.py menuconfig.

    config BATP_BAT_IP
        string "Static IPv4 address on bat0 (empty = DHCP over the mesh)"
        default "10.41.250.2"

    config BATP_BAT_MASK
        string "Netmask on bat0"
        default "255.255.0.0"

    config BATP_ORIG_INTERVAL_MS
        int "OGM2 interval (ms)"
        default 1000

    config BATP_ELP_INTERVAL_MS
        int "ELP interval (ms)"
        default 500

    config BATP_HOP_PENALTY
        int "Hop penalty (0 to 255; Linux default 30)"
        default 30

    config BATP_LINK_THROUGHPUT
        int "Assumed link throughput to each neighbour, in 100 kbit/s units (Linux default 10)"
        default 10

endmenu
```

## firmware/halowchat/main/Kconfig.projbuild
```kconfig
menu "HalowChat"

    config CHAT_HALOW_SSID
        string "HaLow network name"
        default "HalowChat"
        help
            Every board scans for this network at boot and joins it, or starts it
            if nobody has.

    config CHAT_HALOW_PSK
        string "HaLow passphrase (WPA3-SAE)"
        default "change-me-please"

    config CHAT_S1G_CHANNEL
        int "HaLow channel (S1G channel number)"
        range 1 51
        default 26
        help
            The one channel the whole network uses. 26 = 915 MHz, 2 MHz wide.
            US channels sit at 902 + 0.5 x N MHz.

    config CHAT_S1G_OPCLASS
        int "HaLow operating class"
        range 68 71
        default 69
        help
            68 = 1 MHz, 69 = 2 MHz, 70 = 4 MHz, 71 = 8 MHz.

    config CHAT_HALOW_MAX_TX_DBM
        int "Cap HaLow TX power (dBm, 0 = regulatory maximum)"
        range 0 30
        default 8
        help
            Keep it low on the desk: boards a few feet apart overload each other,
            and weak USB ports can't feed full power. Changeable from the page.

    config CHAT_ROLE
        int "Role (0 = auto, 1 = always the hub, 2 = always a member)"
        range 0 2
        default 0
        help
            Auto: scan for the network and join it, or start it if nobody has. Pin a
            board as the hub when its power supply can't handle the station's scan
            probes (see the Ottercam bridge README). Changeable from the page.

    config CHAT_WIFI_PSK
        string "Phone hotspot password (WPA2, 8+ characters)"
        default "halowchat"
        help
            Each board's hotspot is named HalowChat-XXXX from its own address.

    config CHAT_WIFI_CHANNEL
        int "Phone hotspot channel"
        range 1 11
        default 6

    config CHAT_WEB_PORT
        int "Web page port"
        range 1 65535
        default 80

    config CHAT_UDP_PORT
        int "Chat UDP port on the HaLow network"
        range 1024 65535
        default 4242

    config CHAT_HALOW_SPI_MAX_HZ
        int "Cap the HaLow SPI clock (Hz)"
        range 1000000 50000000
        default 40000000

    config CHAT_HALOW_RESET_HOLD_MS
        int "Hold the HaLow chip in reset this long (ms)"
        range 5 20000
        default 8000

    config CHAT_HALOW_RESET_SETTLE_MS
        int "HaLow chip boot time after reset (ms)"
        range 20 2000
        default 250

endmenu
```

## firmware/halowmesh/main/Kconfig.projbuild
```kconfig
menu "HalowChat mesh"

    config CHAT_MESH_ID
        string "Mesh name (802.11s Mesh ID)"
        default "HalowChat"
        help
            Boards with the same mesh name on the same channel find each other from
            their beacons and relay for each other. No hub, no joining.

    config CHAT_S1G_CHANNEL
        int "HaLow channel (S1G channel number)"
        range 1 51
        default 26
        help
            The one channel the whole mesh uses. 26 = 915 MHz, 2 MHz wide.
            US channels sit at 902 + 0.5 x N MHz.

    config CHAT_S1G_OPCLASS
        int "HaLow operating class"
        range 68 71
        default 69
        help
            68 = 1 MHz, 69 = 2 MHz, 70 = 4 MHz, 71 = 8 MHz.

    config CHAT_HALOW_MAX_TX_DBM
        int "Cap HaLow TX power (dBm, 0 = regulatory maximum)"
        range 0 30
        default 8
        help
            Keep it low on the desk: boards a few feet apart overload each other,
            and weak USB ports can't feed full power. Changeable from the page.

    config CHAT_MESH_TTL
        int "Hop limit for relayed frames"
        range 1 31
        default 8

    config CHAT_MESH_PEERING
        bool "Require the 802.11s peering handshake before exchanging data"
        default y
        help
            Boards do the Mesh Peering Open/Confirm exchange and only pass data with
            neighbours that completed it, the way Linux mesh points do. Off means any
            board with the same mesh name is trusted on sight.

    config CHAT_WIFI_PSK
        string "Phone hotspot password (WPA2, 8+ characters)"
        default "halowchat"
        help
            Each board's hotspot is named HalowChat-XXXX from its own address.

    config CHAT_WIFI_CHANNEL
        int "Phone hotspot channel"
        range 1 11
        default 6

    config CHAT_WEB_PORT
        int "Web page port"
        range 1 65535
        default 80

    config CHAT_UDP_PORT
        int "Chat UDP port on the mesh"
        range 1024 65535
        default 4242

    config CHAT_HALOW_SPI_MAX_HZ
        int "Cap the HaLow SPI clock (Hz)"
        range 1000000 50000000
        default 40000000

    config CHAT_HALOW_RESET_HOLD_MS
        int "Hold the HaLow chip in reset this long (ms)"
        range 5 20000
        default 8000

    config CHAT_HALOW_RESET_SETTLE_MS
        int "HaLow chip boot time after reset (ms)"
        range 20 2000
        default 250

endmenu
```

## firmware/hopnode/main/Kconfig.projbuild
```kconfig
menu "hopnode"

    config HOP_MESH_ID
        string "Mesh name (802.11s Mesh ID)"
        default "OpenMANET-XIAO"

    config HOP_MESH_PASSWORD
        string "Mesh password (SAE); leave empty for an open mesh"
        default ""
        help
            Set the same password on every node, including the Linux ones (the OpenWrt
            mesh "key" with encryption sae). Up to 63 characters. Never printed.

    config HOP_S1G_CHANNEL
        int "HaLow channel (S1G channel number)"
        range 1 51
        default 26

    config HOP_S1G_OPCLASS
        int "HaLow operating class"
        range 68 71
        default 69

    config HOP_TX_DBM
        int "Cap HaLow TX power (dBm, 0 = regulatory maximum)"
        range 0 30
        default 8

    config HOP_BAT_SUBNET
        string "bat0 subnet (the node takes .<last byte of its bat address>)"
        default "10.41.250.0"

    config HOP_BAT_MASK
        string "bat0 netmask"
        default "255.255.0.0"

    config HOP_PING_PEERS
        bool "Ping every known bat0 node over the mesh every 5 s and log the result"
        default y

    config HOP_HALOW_SPI_MAX_HZ
        int "Cap the HaLow SPI clock (Hz)"
        range 1000000 50000000
        default 40000000

    config HOP_HALOW_RESET_HOLD_MS
        int "Hold the HaLow chip in reset this long (ms)"
        range 5 20000
        default 8000

    config HOP_HALOW_RESET_SETTLE_MS
        int "HaLow chip boot time after reset (ms)"
        range 20 2000
        default 250

endmenu
```

## firmware/openmanet-gateway/main/Kconfig.projbuild
```kconfig
menu "OpenMANET XIAO Gateway: mesh role"

    config GW_DEFAULT_ROLE_MESH
        bool "Factory-fresh nodes start in the mesh role"
        default y
        help
            With this on, a node that has never been configured comes up as a mesh
            node: phone hotspot plus the HaLow mesh. Off keeps the original default,
            the client role (HaLow station to an access point).

    config GW_MESH_ID
        string "Mesh name (802.11s Mesh ID)"
        default "OpenMANET-XIAO"
        help
            Boards with the same mesh name on the same channel find each other from
            their beacons and relay for each other.

    config GW_MESH_S1G_CHANNEL
        int "HaLow channel (S1G channel number)"
        range 1 51
        default 26
        help
            26 = 915 MHz, 2 MHz wide (US). US channels sit at 902 + 0.5 x N MHz.

    config GW_MESH_S1G_OPCLASS
        int "HaLow operating class"
        range 68 71
        default 69
        help
            68 = 1 MHz, 69 = 2 MHz, 70 = 4 MHz, 71 = 8 MHz.

    config GW_MESH_TX_DBM
        int "Cap HaLow TX power (dBm, 0 = regulatory maximum)"
        range 0 30
        default 8
        help
            Keep it low on the desk: boards a few feet apart overload each other,
            and weak USB ports cannot feed full power. Set 0 for the field.

    config GW_MESH_TTL
        int "Hop limit for relayed frames"
        range 1 31
        default 8

    config GW_MESH_SPI_MAX_HZ
        int "Cap the HaLow SPI clock (Hz)"
        range 1000000 50000000
        default 40000000

    config GW_MESH_RESET_HOLD_MS
        int "Hold the HaLow chip in reset this long (ms)"
        range 5 20000
        default 8000

    config GW_MESH_RESET_SETTLE_MS
        int "HaLow chip boot time after reset (ms)"
        range 20 2000
        default 250

endmenu
```
